## drivers/staging/rtl8821ae/Kconfig
```kconfig
config R8821AE
	tristate "Realtek RTL8821AE Wireless Network Adapter"
	depends on MAC80211
	select FW_LOADER
	select RTLWIFI
	---help---
	This is the driver for Realtek RTL8821AE 802.11 PCIe
	wireless network adapters.

	If you choose to build it as a module, it will be called rtl8821ae

config RTLWIFI
	tristate
	depends on R8821AE
	default m
```
